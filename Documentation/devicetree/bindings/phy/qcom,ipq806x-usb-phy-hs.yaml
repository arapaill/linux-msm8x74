## Documentation/devicetree/bindings/phy/qcom,ipq806x-usb-phy-hs.yaml
```yaml
# SPDX-License-Identifier: GPL-2.0-only OR BSD-2-Clause
%YAML 1.2
---
$id: http://devicetree.org/schemas/phy/qcom,ipq806x-usb-phy-hs.yaml#
$schema: http://devicetree.org/meta-schemas/core.yaml#

title: Qualcomm ipq806x usb DWC3 HS PHY CONTROLLER

maintainers:
  - Ansuel Smith <ansuelsmth@gmail.com>

description:
  DWC3 PHY nodes are defined to describe on-chip Synopsis Physical layer
  controllers used in ipq806x. Each DWC3 PHY controller should have its
  own node.

properties:
  compatible:
    enum:
      - qcom,ipq806x-usb-phy-hs
      - qcom,msm8974-usb-phy-hs

  "#phy-cells":
    const: 0

  reg:
    maxItems: 1

  clocks:
    minItems: 1
    maxItems: 2

  clock-names:
    minItems: 1
    items:
      - const: ref
      - const: xo

  v1p8-supply:
    description: 1.8 V supply of the PHY

  v3p3-supply:
    description: 3.3 V supply of the PHY

required:
  - compatible
  - "#phy-cells"
  - reg
  - clocks
  - clock-names

allOf:
  - if:
      properties:
        compatible:
          contains:
            const: qcom,msm8974-usb-phy-hs
    then:
      required:
        - v1p8-supply
        - v3p3-supply
    else:
      properties:
        v1p8-supply: false
        v3p3-supply: false

additionalProperties: false

examples:
  - |
    #include <dt-bindings/clock/qcom,gcc-ipq806x.h>

    hs_phy_0: phy@110f8800 {
      compatible = "qcom,ipq806x-usb-phy-hs";
      reg = <0x110f8800 0x30>;
      clocks = <&gcc USB30_0_UTMI_CLK>;
      clock-names = "ref";
      #phy-cells = <0>;
    };
```

## drivers/misc/citronics-dln2/Kconfig
```kconfig
# SPDX-License-Identifier: GPL-2.0-only
config CITRONICS_DLN2
	tristate "Citronics Limeboard I/O"
	depends on USB && GPIOLIB && I2C && SPI_MASTER && IIO && COMMON_CLK
	select MFD_CORE
	select GPIOLIB_IRQCHIP
	select IIO_BUFFER
	select IIO_TRIGGERED_BUFFER
	help
	  The Limeboard's STM32 running the Limeboard I/O firmware: its
	  Raspberry Pi style header as a GPIO chip, I2C and SPI buses and
	  an ADC. The firmware speaks the Diolan DLN-2 protocol; this is
	  the kernel's DLN-2 driver set as one separate module that binds
	  to the firmware's USB ID only.

	  To compile this driver as a module, choose M here: the module
	  will be called citronics-dln2.
```
